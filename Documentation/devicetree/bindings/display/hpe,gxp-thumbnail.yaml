## Documentation/devicetree/bindings/display/hpe,gxp-thumbnail.yaml
```yaml
# SPDX-License-Identifier: (GPL-2.0-only OR BSD-2-Clause)
%YAML 1.2
---
$id: http://devicetree.org/schemas/display/hpe,gxp-thumbnail.yaml#
$schema: http://devicetree.org/meta-schemas/core.yaml#

title: GXP HPE VIDEO THUMBNAIL DRIVER

maintainers:
  - Nick Hawkins <nick.hawkins@hpe.com>
  - Jean-Marie Verdun <verdun@hpe.com>

properties:
  compatible:
    const: hpe,gxp-thumbnail

  reg:
    maxItems: 1

  bits-per-pixel:
    $ref: /schemas/types.yaml#/definitions/uint32
    description: The number of bits per pixel in the thumbnail.

  width:
    $ref: /schemas/types.yaml#/definitions/uint32
    description: The width in pixels of the video.

  height:
    $ref: /schemas/types.yaml#/definitions/uint32
    description: The height in pixels of the video.

required:
  - compatible
  - reg
  - bits-per-pixel
  - width
  - height

additionalProperties: false

examples:
  - |
    thumbnail: thumbnail@c0000500 {
      compatible = "hpe,gxp-thumbnail";
      reg = <0xc0000500 0x20>;
      bits-per-pixel = <32>;
      width = <800>;
      height = <600>;
    };
```

## Documentation/devicetree/bindings/gpio/hpe,gxp-gpio.yaml
```yaml
# SPDX-License-Identifier: (GPL-2.0 OR BSD-2-Clause)
%YAML 1.2
---
$id: http://devicetree.org/schemas/gpio/hpe,gxp-gpio.yaml#
$schema: http://devicetree.org/meta-schemas/core.yaml#

title: HPE GXP GPIO INTERFACE

maintainers:
  - Nick Hawkins <nick.hawkins@hpe.com>
  - Jean-Marie Verdun <verdun@hpe.com>

properties:
  compatible:
    const: hpe,gxp-gpio

  gpio-controller: true

  "#gpio-cells":
    const: 2

  csm_interface:
    description: Link to the csm interface.

  vuhc0_interface:
    description: Link to the virtual usb hub controller (VUHC).

required:
  - compatible
  - "#gpio-cells"
  - csm_interface
  - vuhc0_interface
  - gpio-controller

additionalProperties: false

examples:
  - |
    gpio {
      compatible = "hpe,gxp-gpio";
      #gpio-cells = <2>;
      gpio-controller;
      csm_interface = <&csm>;
      vuhc0_interface = <&vuhc0>;
    };
```

## Documentation/devicetree/bindings/i2c/hpe,gxp-i2c.yaml
```yaml
# SPDX-License-Identifier: (GPL-2.0 OR BSD-2-Clause)
%YAML 1.2
---
$id: http://devicetree.org/schemas/i2c/hpe,gxp-i2c.yaml#
$schema: http://devicetree.org/meta-schemas/core.yaml#

title: HPE GXP I2C Interface

maintainers:
  - Nick Hawkins <nick.hawkins@hpe.com>
  - Jean-Marie Verdun <verdun@hpe.com>

allOf:
  - $ref: i2c-controller.yaml#

properties:
  compatible:
    const: hpe,gxp-i2c

  reg:
    maxItems: 1

  interrupts:
    maxItems: 1

  i2cg_interface:
    description: Link to the Global interrupt status register handler.

required:
  - compatible
  - reg
  - interrupts
  - interrupt-parent
  - i2cg-interface

unevaluatedProperties: false

examples:
  - |
    i2c0: i2c@c0002000 {
      compatible = "hpe,gxp-i2c";
      reg = <0xc0002000 0x70>;
      interrupts = <9>;
      interrupt-parent = <&vic0>;
      i2cg-interface = <&i2cg>;
    };
```

## Documentation/devicetree/bindings/ipmi/hpe,gxp-kcs-bmc-cfg.yaml
```yaml
# SPDX-License-Identifier: (GPL-2.0-only OR BSD-2-Clause)
%YAML 1.2
---
$id: http://devicetree.org/schemas/ipmi/hpe,gxp-kcs-bmc-cfg.yaml#
$schema: http://devicetree.org/meta-schemas/core.yaml#

title: HPE GXP KCS IPMI DRIVER CFG

maintainers:
  - Nick Hawkins <nick.hawkins@hpe.com>
  - Jean-Marie Verdun <verdun@hpe.com>

properties:
  compatible: 
    items:
      - const: hpe,gxp-kcs-bmc-cfg
      - const: simple-mfd
      - const: syscon

  reg:
    maxItems: 1

required:
  - compatible
  - reg

additionalProperties: false

examples:
  - |
    kcs_conf: kcs_conf@80fc0430 {
      compatible = "hpe,gxp-kcs-bmc-cfg", "simple-mfd", "syscon";
      reg = <0x80fc0430 0x100>;
    };
```

## Documentation/devicetree/bindings/ipmi/hpe,gxp-kcs-bmc.yaml
```yaml
# SPDX-License-Identifier: (GPL-2.0-only OR BSD-2-Clause)
%YAML 1.2
---
$id: http://devicetree.org/schemas/ipmi/hpe,gxp-kcs-bmc.yaml#
$schema: http://devicetree.org/meta-schemas/core.yaml#

title: HPE GXP KCS IPMI DRIVER

maintainers:
  - Nick Hawkins <nick.hawkins@hpe.com>
  - Jean-Marie Verdun <verdun@hpe.com>

properties:
  compatible:
    const: hpe,gxp-kcs-bmc

  reg:
    maxItems: 1

  interrupts:
    maxItems: 1

  kcs_chan:
    $ref: /schemas/types.yaml#/definitions/uint32
    description: The number of the kcs channel.
    
  kcs-bmc-cfg:
    description: Link to the kcs configuration interface.

required:
  - compatible
  - reg
  - interrupts
  - interrupt-parent
  - kcs_chan
  - kcs-bmc-cfg

additionalProperties: false

examples:
  - |
    kcs_reg: kcs_reg@80fd0400 {
    compatible = "hpe,gxp-kcs-bmc";
    reg = <0x80fd0400 0x8>;
    interrupts = <6>;
    interrupt-parent = <&vic1>;
    kcs_chan = <1>;
    status = "okay";
    kcs-bmc-cfg = <&kcs_conf>;
    };
```

## Documentation/devicetree/bindings/memory-controllers/hpe,gxp-srom.yaml
```yaml
# SPDX-License-Identifier: GPL-2.0
%YAML 1.2
---
$id: http://devicetree.org/schemas/memory-controllers/hpe,gxp-srom.yaml#
$schema: http://devicetree.org/meta-schemas/core.yaml#

title: HPE GXP SROM CONTROLLER

maintainers:
  - Nick Hawkins <nick.hawkins@hpe.com>
  - Jean-Marie Verdun <verdun@hpe.com>

properties:
  compatible: 
    items:
      - const: hpe,gxp-srom
      - const: simple-mfd
      - const: syscon

  reg:
    maxItems: 1

required:
  - compatible
  - reg

additionalProperties: false

examples:
  - |
    srom@80fc0000 {
      compatible = "hpe,gxp-srom", "simple-mfd", "syscon";
      reg = <0x80fc0000 0x100>;
    };
```

## Documentation/devicetree/bindings/net/hpe,gxp-umac-mdio.yaml
```yaml
# SPDX-License-Identifier: GPL-2.0-only OR BSD-2-Clause
%YAML 1.2
---
$id: http://devicetree.org/schemas/net/hpe,gxp-umac-mdio.yaml#
$schema: http://devicetree.org/meta-schemas/core.yaml#

title: HPE GXP UMAC MDIO INTERFACE

maintainers:
  - Nick Hawkins <nick.hawkins@hpe.com>
  - Jean-Marie Verdun <verdun@hpe.com>

properties:
  compatible: 
    const: hpe,gxp-umac-mdio

  '#address-cells':
    const: 1

  '#size-cells':
    const: 0

  reg:
    maxItems: 1

  ethernet-phy@0:
    type: object
    properties:
      compatible:
        const: ethernet-phy-ieee802.3-c22
      phy-mode:
        description: Current mode of the phy.
      reg:
        maxItems: 1

required:
  - compatible
  - reg
  - '#address-cells'
  - '#size-cells'

additionalProperties: false

examples:
  - |
    mdio0: mdio@c0004080 {
      compatible = "hpe,gxp-umac-mdio";
      reg = <0xc0004080 0x10>;
      #address-cells = <1>;
      #size-cells = <0>;
      ext_phy0: ethernet-phy@0 {
        compatible = "ethernet-phy-ieee802.3-c22";
        phy-mode = "sgmii";
        reg = <0>;
      };
    };
```

## Documentation/devicetree/bindings/net/hpe,gxp-umac.yaml
```yaml
# SPDX-License-Identifier: GPL-2.0-only OR BSD-2-Clause
%YAML 1.2
---
$id: http://devicetree.org/schemas/net/hpe,gxp-umac.yaml#
$schema: http://devicetree.org/meta-schemas/core.yaml#

title: HPE GXP UMAC INTERFACE

maintainers:
  - Nick Hawkins <nick.hawkins@hpe.com>
  - Jean-Marie Verdun <verdun@hpe.com>

properties:
  compatible: 
    const: hpe,gxp-umac

  reg:
    maxItems: 1

  interrupts:
    maxItems: 1

  phy-handle:
    description: 
      Phandle to a PHY on the MDIO bus.

  int-phy-handle:
    description:
      Phandle to PHY interrupt handler.

required:
  - compatible
  - reg
  - interrupts
  - interrupt-parent
  - phy-handle
  - int-phy-handle

additionalProperties: false

examples:
  - |
    umac0: umac@c0004000 {
      compatible = "hpe,gxp-umac";
      reg = <0xc0004000 0x80>;
      interrupts = <10>;
      interrupt-parent = <&vic0>;
      phy-handle = <&ext_phy0>;
      int-phy-handle = <&int_phy0>;
    };
```

## Documentation/devicetree/bindings/pwm/hpe,gxp-fan.yaml
```yaml
# SPDX-License-Identifier: GPL-2.0
%YAML 1.2
---
$id: http://devicetree.org/schemas/pwm/hpe,gxp-fan.yaml#
$schema: http://devicetree.org/meta-schemas/core.yaml#

title: HPE GXP FAN CONTROL INTERFACE

maintainers:
  - Nick Hawkins <nick.hawkins@hpe.com>
  - Jean-Marie Verdun <verdun@hpe.com>

properties:
  compatible:
    const: hpe,gxp-fan

  reg:
    maxItems: 1

  xreg_interface:
    description: Link to the xreg interface.

  fn2_interface:
    description: Link to the fn2 interface.

required:
  - compatible
  - reg
  - xreg_interface
  - fn2_interface

additionalProperties: false

examples:
  - |
    fanctrl: fanctrl@c1000c00 {
      compatible = "hpe,gxp-fan-ctrl";
      reg = <0xc1000c00 0x200>;
      xreg_interface = <&xreg>;
      fn2_interface = <&fn2>;
    };
```

## Documentation/devicetree/bindings/serial/hpe,gxp-vuart-cfg.yaml
```yaml
# SPDX-License-Identifier: GPL-2.0-only OR BSD-2-Clause
%YAML 1.2
---
$id: http://devicetree.org/schemas/serial/hpe,gxp-vuart-cfg.yaml#
$schema: http://devicetree.org/meta-schemas/core.yaml#

title: HPE GXP VUART CFG INFERFACE

maintainers:
  - Nick Hawkins <nick.hawkins@hpe.com>
  - Jean-Marie Verdun <verdun@hpe.com>

properties:
  compatible: 
    items:
      - const: hpe,gxp-vuart-cfg
      - const: simple-mfd
      - const: syscon

  reg:
    maxItems: 1

  reg-io-width: true

required:
  - compatible
  - reg
  - reg-io-width

additionalProperties: false

examples:
  - |
    vuart_a_cfg: vuarta_cfg@80fc0230 {
      compatible = "hpe,gxp-vuarta_cfg", "simple-mfd", "syscon";
      reg = <0x80fc0230 0x100>;
      reg-io-width = <1>;
    };
```

## Documentation/devicetree/bindings/serial/hpe,gxp-vuart.yaml
```yaml
# SPDX-License-Identifier: GPL-2.0-only OR BSD-2-Clause
%YAML 1.2
---
$id: http://devicetree.org/schemas/serial/hpe,gxp-vuart.yaml#
$schema: http://devicetree.org/meta-schemas/core.yaml#

title: HPE GXP VUART INFERFACE

maintainers:
  - Nick Hawkins <nick.hawkins@hpe.com>
  - Jean-Marie Verdun <verdun@hpe.com>

properties:
  compatible:
    const: hpe,gxp-vuart

  reg:
    maxItems: 1

  interrupts:
    maxItems: 1

  clock-frequency: true

  reg-shift:
    description: Quantity to shift the register offsets by.
    
  status:
    $ref: /schemas/types.yaml#/definitions/string
    description: The status signal from the controller.

  serial-line:
    $ref: /schemas/types.yaml#/definitions/uint32
    description: The serial line number.

  vuart_cfg:
    description: Link to the vuart configuration interface.

required:
  - compatible
  - reg
  - interrupts
  - interrupt-parent
  - clock-frequency
  - reg-shift
  - status
  - serial-line
  - vuart_cfg

additionalProperties: false

examples:
  - |
    vuart_a: vuart_a@80fd0200 {
      compatible = "hpe,gxp-vuart";
      reg = <0x80fd0200 0x100>;
      interrupts = <2>;
      interrupt-parent = <&vic1>;
      clock-frequency = <1846153>;
      reg-shift = <0>;
      status = "okay";
      serial-line = <3>;
      vuart_cfg = <&vuart_a_cfg>;
    };
```

## Documentation/devicetree/bindings/soc/hpe/hpe,gxp-csm.yaml
```yaml
# SPDX-License-Identifier: GPL-2.0-only OR BSD-2-Clause
%YAML 1.2
---
$id: http://devicetree.org/schemas/soc/hpe/hpe,gxp-csm.yaml#
$schema: http://devicetree.org/meta-schemas/core.yaml#

title: HPE GXP PCI CSM INTERFACE

maintainers:
  - Nick Hawkins <nick.hawkins@hpe.com>
  - Jean-Marie Verdun <verdun@hpe.com>

properties:
  compatible: 
    items:
      - const: hpe,gxp-csm
      - const: simple-mfd

  reg:
    items:
      - description: ASRSTAT register
      - description: AFUNEN2 register
      - description: SHUTDOWN register

required:
  - compatible
  - reg

additionalProperties: false

examples:
  - |
    csm: csm@8000005c {
      compatible = "hpe,gxp-csm", "simple-mfd";
      reg = <0x8000005c 0x2>, <0x800000de 0x1>, <0x800000e7 0x1>;
    };
```

## Documentation/devicetree/bindings/soc/hpe/hpe,gxp-dbg.yaml
```yaml
# SPDX-License-Identifier: GPL-2.0-only OR BSD-2-Clause
%YAML 1.2
---
$id: http://devicetree.org/schemas/soc/hpe/hpe,gxp-dbg.yaml#
$schema: http://devicetree.org/meta-schemas/core.yaml#

title: HPE GXP CHIF INTERFACE

maintainers:
  - Nick Hawkins <nick.hawkins@hpe.com>
  - Jean-Marie Verdun <verdun@hpe.com>

description: |
  Specify host debug interface. Used presently to report ROM POST
  code during host initialization phases.

properties:
  compatible: 
    const: hpe,gxp-dbg

  reg:
    maxItems: 1

  interrupts:
    maxItems: 1

required:
  - compatible
  - reg
  - interrupts
  - interrupt-parent

additionalProperties: false

examples:
  - |
    post@800000a0 {
      compatible = "hpe,gxp-dbg";
      reg = <0x800000a0 0x20>;
      interrupts = <10>;
      interrupt-parent = <&vic1>;
    };
```

## Documentation/devicetree/bindings/soc/hpe/hpe,gxp-fn2.yaml
```yaml
# SPDX-License-Identifier: GPL-2.0-only OR BSD-2-Clause
%YAML 1.2
---
$id: http://devicetree.org/schemas/soc/hpe/hpe,gxp-fn2.yaml#
$schema: http://devicetree.org/meta-schemas/core.yaml#

title: HPE GXP FN2 INTERFACE

maintainers:
  - Nick Hawkins <nick.hawkins@hpe.com>
  - Jean-Marie Verdun <verdun@hpe.com>

properties:
  compatible: 
    items:
      - const: hpe,gxp-fn2
      - const: simple-mfd
      - const: syscon

  reg:
    maxItems: 1

  gpio-controller: true

  xreg_interface:
    description: Link to the xreg interface.

  interrupts:
    maxItems: 1

  "#gpio-cells":
    const: 2

required:
  - compatible
  - reg
  - xreg_interface
  - interrupts
  - interrupt-parent
  - "#gpio-cells"
  - gpio-controller

additionalProperties: false

examples:
  - |
    fn2: fn2@80200000 {
      compatible = "hpe,gxp-fn2", "simple-mfd", "syscon";
      reg = <0x80200000 0x100000>;
      xreg_interface = <&xreg>;
      interrupts = <0>;
      interrupt-parent = <&vic1>;
      gpio-controller;
      #gpio-cells = <2>;
    };
```

## Documentation/devicetree/bindings/soc/hpe/hpe,gxp-xreg.yaml
```yaml
# SPDX-License-Identifier: GPL-2.0-only OR BSD-2-Clause
%YAML 1.2
---
$id: http://devicetree.org/schemas/soc/hpe/hpe,gxp-xreg.yaml#
$schema: http://devicetree.org/meta-schemas/core.yaml#

title: HPE GXP XREG INTERFACE

maintainers:
  - Nick Hawkins <nick.hawkins@hpe.com>
  - Jean-Marie Verdun <verdun@hpe.com>

properties:
  compatible: 
    items:
      - const: hpe,gxp-xreg
      - const: simple-mfd
      - const: syscon

  reg:
    maxItems: 1

  interrupts:
    maxItems: 1

required:
  - compatible
  - reg
  - interrupts
  - interrupt-parent

additionalProperties: false

examples:
  - |
    xreg: xreg@d1000300 {
      compatible = "hpe,gxp-xreg", "simple-mfd", "syscon";
      reg = <0xd1000300 0xff>;
      interrupts = <26>;
      interrupt-parent = <&vic0>;
    };
```
