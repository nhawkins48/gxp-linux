## Documentation/devicetree/bindings/spi/hpe,gxp-spifi.yaml
```yaml
# SPDX-License-Identifier: (GPL-2.0-only OR BSD-2-Clause)
%YAML 1.2
---
$id: http://devicetree.org/schemas/spi/hpe,gxp-spifi.yaml#
$schema: http://devicetree.org/meta-schemas/core.yaml#

title: HPE GXP SPI FLASH INTERFACE

maintainers:
  - Nick Hawkins <nick.hawkins@hpe.com>
  - Jean-Marie Verdun <verdun@hpe.com>

allOf:
  - $ref: "spi-controller.yaml#"

properties:
  compatible:
    const: hpe,gxp-spifi

  reg:
    items:
      - description: SPIMCFG register
      - description: SPIDAT register
      - description: SPICTRL register

  interrupts:
    maxItems: 1

  partitions:
    type: object
    description:
      Node containing description of fixed partitions.
      See Documentation/devicetree/bindings/mtd/partition.txt

patternProperties:
  "flash@[0-9a-f]+$":
    type: object
    properties:
      compatible:
        const: jedec,spi-nor

required:
  - compatible
  - reg
  - interrupts
  - '#address-cells'
  - '#size-cells'

unevaluatedProperties: false

examples:
  - |
    spifi0: spi@c0000200 {
      compatible = "hpe,gxp-spifi";
      reg = <0xc0000200 0x80>, <0xc000c000 0x100>, <0xf8000000 0x8000000>;
      interrupts = <20>;
      interrupt-parent = <&vic0>;
      #address-cells = <1>;
      #size-cells = <0>;
      flash@0 {
        compatible = "jedec,spi-nor";
        reg = <0>;
        partitions {
          compatible = "fixed-partitions";
          #address-cells = <1>;
          #size-cells = <1>;
          u-boot@0 {
            label = "u-boot";
            reg = <0x0 0x60000>;
          };
          u-boot-env@60000 {
            label = "u-boot-env";
            reg = <0x60000 0x20000>;
          };
          kernel@80000 {
            label = "kernel";
            reg = <0x80000 0x4c0000>;
          };
          rofs@540000 {
            label = "rofs";
            reg = <0x540000 0x1740000>;
          };
          rwfs@1c80000 {
            label = "rwfs";
            reg = <0x1c80000 0x250000>;
          };
          section@1edf000{
            label = "section";
            reg = <0x1ed0000 0x130000>;
          };
        };
      };

      flash@1 {
        compatible = "jedec,spi-nor";
        reg = <1>;
        partitions {
          compatible = "fixed-partitions";
          #address-cells = <1>;
          #size-cells = <1>;
          host-prime@0 {
            label = "host-prime";
            reg = <0x0 0x02000000>;
          };
          host-second@2000000 {
            label = "host-second";
            reg = <0x02000000 0x02000000>;
          };
        };
      };
    };
```

## Documentation/devicetree/bindings/thermal/hpe,gxp-coretemp.yaml
```yaml
# SPDX-License-Identifier: (GPL-2.0-only OR BSD-2-Clause)
%YAML 1.2
---
$id: http://devicetree.org/schemas/thermal/hpe,gxp-coretemp.yaml#
$schema: http://devicetree.org/meta-schemas/core.yaml#

title: HPE GXP CORETEMP INTERFACE

maintainers:
  - Nick Hawkins <nick.hawkins@hpe.com>
  - Jean-Marie Verdun <verdun@hpe.com>

properties:
  compatible:
    const: hpe,gxp-coretemp

  reg:
    maxItems: 1

required:
  - compatible
  - reg

additionalProperties: false

examples:
  - |
    coretemp: coretemp@c0000130 {
      compatible = "hpe,gxp-coretemp";
      reg = <0xc0000130 0x8>;
    };
```

## Documentation/devicetree/bindings/usb/hpe,gxp-udc.yaml
```yaml
# SPDX-License-Identifier: (GPL-2.0-only OR BSD-2-Clause)
# Copyright (c) 2020 Facebook Inc.
%YAML 1.2
---
$id: http://devicetree.org/schemas/usb/hpe,gxp-udc.yaml#
$schema: http://devicetree.org/meta-schemas/core.yaml#

title: HPE USB Device Port Controller

maintainers:
  - Nick Hawkins <nick.hawkins@hpe.com>
  - Jean-Marie Verdun <verdun@hpe.com>

properties:
  compatible:
    const: hpe,gxp-udc

  reg:
    maxItems: 1

  clocks:
    maxItems: 1

  interrupts:
    maxItems: 1

  vdevnum:
    description: The particular usb device controller port.
    $ref: /schemas/types.yaml#/definitions/uint32
    maximum: 65535

  fepnum:
    description: The particular usb device controller options.
    $ref: /schemas/types.yaml#/definitions/uint32
    maximum: 65535

  udcg-handle:
    description: Phandle to the usb device controller hub.

required:
  - compatible
  - reg
  - interrupts
  - vdevnum
  - fepnum
  - udcg-handle

additionalProperties: false

examples:
  - |
    udc0: udc@80401000 {
            compatible = "hpe,gxp-udc";
            reg = <0x80401000 0x1000>;
            interrupts = <13>;
            interrupt-parent = <&vic1>;
            vdevnum = <0>;
            fepnum = <7>;
            udcg-handle = <&udcg>;
    };
```
